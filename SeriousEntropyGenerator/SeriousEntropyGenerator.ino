// Generated by Glitch!
// Wed Nov 15 08:03:23 2023

#include <Ethernet.h>

IPAddress ip(192, 168, 178, 85);

EthernetServer server(5000);

/* The MAC address must be unique. Arduino's Ethernet Shield does not have a MAC address. */

byte mac[]  = {0xaa, 0xbb, 0xcc, 0xdd, 0xee, 0xff};

int previous[]  = {0, 0, 0, 0, 0, 0, 0, 0};

void loop(void)
{
 while(true)
 {
  /* Read values from pins A8 through A15. The pins must be disconnected! */
  EthernetClient client = server.available();
  String buffer  = "";
  int pins[]  = {A8, A9, A10, A11, A12, A13, A14, A15};
  for(int i = 0; i < 8;)
  {
   auto value  = analogRead(pins[i]);
   if(value == 0)
   {
    continue;
   }
   else
   {
    if(client && client.connected())
    {
     auto ip_address  = client.remoteIP();
     auto ip_address_numeric  = ip_address[0] | (ip_address[1] << 8) | (ip_address[1] << 16) | (ip_address[3] << 24);
     buffer.concat(((previous[i]) ^ (value) ^ (((((ip_address_numeric) >> (4 * i))) & (0xf)))));
    }
    else
    {
     buffer.concat(((previous[i]) ^ (value)));
    }
    previous[i] = ((previous[i]) ^ (value));
    (i)++;
   }
   delayMicroseconds(value);
  }
  if(client)
  {
   if(client.connected())
   {
    client.read();
    client.println(buffer);
   }
   else
   {
    client.stop();
   }
  }
  else
  {
   break;
  }
  delay(10);
 }
 delay(10);
}

void setup(void)
{
 Ethernet.begin(mac, ip);
 server.begin();
}
